#include <avr/io.h>
#include <util/delay.h>

#define boton0 (1 << PC0) // Pin del botón conectado a PC0
#define boton1 (1 << PC1) // Pin del botón conectado a PC1
#define boton2 (1 << PC2) // Pin del botón conectado a PC2
#define boton3 (1 << PC3) // Pin del botón conectado a PC3


unsigned char PORT[8] = {1, 2, 4, 8, 16, 32, 64, 128}; // Valores de pines de PORTD

//Mensaje en desplazamiento por columnas
unsigned char MENSAJE_C[] = {
        0x00,0x66,0x66,0x7e,0x7e,0x06,0x06,0x00, // J
        0x00,0x7E,0x7E,0x42,0x42,0x7E,0x7E,0x00, // O
        0x00,0x7E,0x7E,0x12,0x32,0x7E,0x5E,0x00, // R
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        0x00,0x00,0x00,0x00,0x00,0x00,0x00,0x00, // ESPACIO
    };

//Mensaje en desplazamiento por filas
unsigned char MENSAJE_F[] = {
        0x00,0x7E,0x7E,0x18,0x18,0x1E,0x1E,0x00, // J
        0x00,0x7E,0x7E,0x66,0x66,0x7E,0x7E,0x00, // O
        0x00,0x7E,0x66,0x66,0x7E,0x36,0x66,0x00, // R
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        0x07,0x0E,0x1C,0xF8,0xF8,0x1C,0x0E,0x07, // SUDAFRICA
    };

int limite_desplazamiento = sizeof(MENSAJE_C) - 8;

void derecha_izquierda(){
        for(int i = 0; i <= limite_desplazamiento; i++){   
                // Retención de la imagen para determinar la velocidad del desplazamiento
                for(int k = 0; k < 50; k++){
                    // Barrido de las 8 columnas
                    for(int j = 0; j < 8; j++){
                        PORTB = 0xFF;            // Apaga las filas para evitar el efecto fantasma
                        PORTD = PORT[j];         // Selecciona la nueva columna
                        PORTB = ~MENSAJE_C[i + j]; // Muestra el patrón negado
                        _delay_ms(0.2);            // Retraso para mantener la persistencia de la visión
                    }
                }
                if (!(PINC & boton0)) return; // Si el botón está presionado, salir de la función para detener el desplazamiento
        }
    }

void abajo_arriba() {
  for (int i = 0; i < limite_desplazamiento; i++) {
    for (int k =0; k < 50; k++) {
      for (int j = 0; j < 8; j++) {
        PORTB = PORT[j]; // Selecciona la columna
        PORTD = MENSAJE_F[i + j]; // Envía el byte correspondiente a la fila
        _delay_ms(0.2); // Retardo para controlar la velocidad de desplazamiento
      }
      if (!(PINC & boton1)) return;
    }
  }
}

void izquierda_derecha(){
        for(int i = limite_desplazamiento; i >= 0; i--){   
                // Retención de la imagen para determinar la velocidad del desplazamiento
                for(int k = 0; k < 50; k++){
                    // Barrido de las 8 columnas
                    for(int j = 0; j < 8; j++){
                        PORTB = 0xFF;            // Apaga las filas para evitar el efecto fantasma
                        PORTD = PORT[j];         // Selecciona la nueva columna
                        PORTB = ~MENSAJE_C[i + j]; // Muestra el patrón negado
                        _delay_ms(0.2);            // Retraso para mantener la persistencia de la visión
                    }
                }
                if (!(PINC & boton2)) return; // Si el botón está presionado, salir de la función para detener el desplazamiento
        }
    }

void arriba_abajo() {
  // Invertimos el bucle principal: empieza en el límite y baja hasta 0
  for (int i = limite_desplazamiento; i >= 0; i--) {
    // Retención de imagen (velocidad de animación)
    for (int k = 0; k < 50; k++) {
      // Barrido de las 8 posiciones
      for (int j = 0; j < 8; j++) {
        PORTB = PORT[j]; // Selecciona la columna / fila
        PORTD = MENSAJE_F[i + j]; // Envía el byte correspondiente
        _delay_ms(0.2); // Retardo de multiplexación
      }
      
      // Condición de salida si se presiona el botón
      if (!(PINC & boton3)) return;
    }
  }
}

int main(void){
    DDRB = 0B11111111; // Configurar PORTB como salida (Columnas)
    DDRD = 0B11111111; // Configurar PORTD como salida (Filas)
    
    PORTC |= boton1; // Habilitar resistencia de pull-up para el botón en PC1
    PORTC |= boton0; // Habilitar resistencia de pull-up para el botón en PC0
    PORTC |= boton2; // Habilitar resistencia de pull-up para el botón en PC2
    PORTC |= boton3; // Habilitar resistencia de pull-up para el botón en PC3

    while(1){ 
        if (!(PINC & boton0)) derecha_izquierda(); // Si el botón está presionado, iniciar el desplazamiento de derecha a izquierda
        if (!(PINC & boton1)) abajo_arriba(); // Si el botón está presionado, iniciar el desplazamiento de abajo hacia arriba
        if (!(PINC & boton2)) izquierda_derecha(); // Si el botón está presionado, iniciar el desplazamiento de izquierda a derecha
        if (!(PINC & boton3)) arriba_abajo(); // Si el botón está presionado, iniciar el desplazamiento de arriba hacia abajo

    }
    return 0;
}